## Kconfig
```kconfig
# SPDX-FileCopyrightText: 2026 roolrz
# SPDX-License-Identifier: Apache-2.0

config SYSTEM_APP_CAT
    bool "cat (/bin/cat)"
    default y
    help
        Build and deploy hyper-cat at /bin/cat.

config SYSTEM_APP_CHMOD
    bool "chmod (/bin/chmod)"
    default y
    help
        Build and deploy hyper-chmod at /bin/chmod.

config SYSTEM_APP_CP
    bool "cp (/bin/cp)"
    default y
    help
        Build and deploy hyper-cp at /bin/cp.

config SYSTEM_APP_ECHO
    bool "echo (/bin/echo)"
    default y
    help
        Build and deploy hyper-echo at /bin/echo.

config SYSTEM_APP_LN
    bool "ln (/bin/ln)"
    default y
    help
        Build and deploy hyper-ln at /bin/ln.

config SYSTEM_APP_LS
    bool "ls (/bin/ls)"
    default y
    help
        Build and deploy hyper-ls at /bin/ls.

config SYSTEM_APP_MKDIR
    bool "mkdir (/bin/mkdir)"
    default y
    help
        Build and deploy hyper-mkdir at /bin/mkdir.

config SYSTEM_APP_MV
    bool "mv (/bin/mv)"
    default y
    help
        Build and deploy hyper-mv at /bin/mv.

config SYSTEM_APP_RM
    bool "rm (/bin/rm)"
    default y
    help
        Build and deploy hyper-rm at /bin/rm.

config SYSTEM_APP_RMDIR
    bool "rmdir (/bin/rmdir)"
    default y
    help
        Build and deploy hyper-rmdir at /bin/rmdir.

config SYSTEM_APP_TOUCH
    bool "touch (/bin/touch)"
    default y
    help
        Build and deploy hyper-touch at /bin/touch.
```
